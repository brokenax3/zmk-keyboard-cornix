## config/west.yml
```yaml
manifest:
  remotes:
    - name: zmkfirmware
      url-base: https://github.com/zmkfirmware
    - name: hitsmaxft
      url-base: https://github.com/hitsmaxft
    - name: urob
      url-base: https://github.com/urob
    - name: janpfischer
      url-base: https://github.com/janpfischer
    - name: brokenax3
      url-base: https://github.com/brokenax3
  projects:
    - name: zmk
      remote: zmkfirmware
      revision: main
      clone-depth: 1
      import:
        file: app/west.yml
    - name: zmk-helpers
      remote: urob
      revision: main
      clone-depth: 1
    #- name: zmk-rgbled-widget
    #  remote: hitsmaxft
    #  revision: main
    #  clone-depth: 1
    - name: zmk-dongle-display
      remote: hitsmaxft
      revision: zephyr4
      clone-depth: 1
    - name: zmk-behavior-socd
      remote: brokenax3
      revision: main
    #- name: zmk-dongle-screen
    #  remote: janpfischer
    #  revision: main
    #  clone-depth: 1
  self:
    path: config
```
